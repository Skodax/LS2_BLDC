/**
 * @cliArgs --board "/ti/boards/MSP_EXP432P401R" --product "simplelink_msp432p4_sdk@3.40.01.02"
 * @versions {"data":"2020090214","timestamp":"2020090214","tool":"1.6.0+1543","templates":"2020090214"}
 */

/**
 * Import the modules used in this configuration.
 */
const GPIO    = scripting.addModule("/ti/drivers/GPIO", {}, false);
const GPIO1   = GPIO.addInstance();
const GPIO2   = GPIO.addInstance();
const GPIO3   = GPIO.addInstance();
const GPIO4   = GPIO.addInstance();
const GPIO5   = GPIO.addInstance();
const GPIO6   = GPIO.addInstance();
const GPIO7   = GPIO.addInstance();
const GPIO8   = GPIO.addInstance();
const GPIO9   = GPIO.addInstance();
const GPIO10  = GPIO.addInstance();
const GPIO11  = GPIO.addInstance();
const GPIO12  = GPIO.addInstance();
const GPIO13  = GPIO.addInstance();
const PWM     = scripting.addModule("/ti/drivers/PWM", {}, false);
const PWM1    = PWM.addInstance();
const PWM2    = PWM.addInstance();
const PWM3    = PWM.addInstance();
const PWM4    = PWM.addInstance();
const Power   = scripting.addModule("/ti/drivers/Power");
const RTOS    = scripting.addModule("/ti/drivers/RTOS");
const SPI     = scripting.addModule("/ti/drivers/SPI", {}, false);
const SPI1    = SPI.addInstance();
const Button  = scripting.addModule("/ti/drivers/apps/Button", {}, false);
const Button1 = Button.addInstance();
const Button2 = Button.addInstance();
const LED     = scripting.addModule("/ti/drivers/apps/LED", {}, false);
const LED1    = LED.addInstance();
const LED2    = LED.addInstance();

/**
 * Write custom configuration values to the imported modules.
 */
GPIO1.$name              = "PHASE_A_LIN";
GPIO1.mode               = "Output";
GPIO1.initialOutputState = "High";
GPIO1.gpioPin.$assign    = "expansion.7";

GPIO2.$name              = "PHASE_B_LIN";
GPIO2.mode               = "Output";
GPIO2.initialOutputState = "High";
GPIO2.gpioPin.$assign    = "expansion.32";

GPIO3.$name              = "PHASE_C_LIN";
GPIO3.mode               = "Output";
GPIO3.initialOutputState = "High";
GPIO3.gpioPin.$assign    = "expansion.31";

GPIO4.$name           = "LCD_CS";
GPIO4.mode            = "Dynamic";
GPIO4.gpioPin.$assign = "boosterpack.13";

GPIO5.$name           = "LCD_RST";
GPIO5.mode            = "Dynamic";
GPIO5.gpioPin.$assign = "boosterpack.17";

GPIO6.$name           = "LCD_DC";
GPIO6.mode            = "Dynamic";
GPIO6.gpioPin.$assign = "boosterpack.31";

GPIO7.$name            = "MKII_BUTTON1_GPIO";
GPIO7.pull             = "Pull Up";
GPIO7.interruptTrigger = "Falling Edge";
GPIO7.gpioPin.$assign  = "boosterpack.33";

GPIO8.pull             = "Pull Up";
GPIO8.interruptTrigger = "Falling Edge";
GPIO8.$name            = "MKII_BUTTON2_GPIO";
GPIO8.gpioPin.$assign  = "boosterpack.32";

GPIO9.$name           = "MKII_LED_Red_GPIO";
GPIO9.mode            = "Output";
GPIO9.gpioPin.$assign = "boosterpack.39";

GPIO10.mode            = "Output";
GPIO10.$name           = "MKII_LED_Green_GPIO";
GPIO10.gpioPin.$assign = "boosterpack.38";

GPIO11.mode            = "Output";
GPIO11.$name           = "BEMF_ZCD_GPIO";
GPIO11.gpioPin.$assign = "expansion.12";

GPIO12.$name           = "BEMF_PHC_GPIO";
GPIO12.mode            = "Output";
GPIO12.gpioPin.$assign = "expansion.10";

GPIO13.$name           = "BEMF_PHC_CLC_GPIO";
GPIO13.mode            = "Output";
GPIO13.gpioPin.$assign = "expansion.14";

PWM1.$name                = "PHASE_A_HIN";
PWM1.timer.$assign        = "Timer_A1";
PWM1.timer.pwmPin.$assign = "expansion.24";

PWM2.$name                = "PHASE_B_HIN";
PWM2.timer.$assign        = "Timer_A1";
PWM2.timer.pwmPin.$assign = "expansion.26";

PWM3.$name                = "PHASE_C_HIN";
PWM3.timer.$assign        = "Timer_A1";
PWM3.timer.pwmPin.$assign = "expansion.25";

PWM4.$name                = "BEMF_READ_REF";
PWM4.timer.$assign        = "Timer_A1";
PWM4.timer.pwmPin.$assign = "expansion.18";

Power.performanceLevel3.$name = "ti_drivers_power_PowerMSP432PerfLevels0";
Power.performanceLevel2.$name = "ti_drivers_power_PowerMSP432PerfLevels1";
Power.performanceLevel1.$name = "ti_drivers_power_PowerMSP432PerfLevels2";
Power.performanceLevel0.$name = "ti_drivers_power_PowerMSP432PerfLevels3";

RTOS.timer0.resource.$assign = "Timer_A0";

SPI1.$name                             = "LCD_EUSCI_BASE";
SPI1.defaultTxBufferValue              = "0xFF";
SPI1.spi.$assign                       = "EUSCI_B0";
SPI1.spi.sclkPin.$assignAllowConflicts = "boosterpack.7";
SPI1.spi.misoPin.$assign               = "boosterpack.14";
SPI1.spi.mosiPin.$assignAllowConflicts = "boosterpack.15";
SPI1.spi.dmaRxChannel.$assign          = "DMA_CH1";
SPI1.spi.dmaTxChannel.$assign          = "DMA_CH0";
SPI1.spi.dmaInterruptNumber.$assign    = "DMA_INT1";

Button1.$name         = "Board_BUTTON_S1";
Button1.$hardware     = system.deviceData.board.components.S1;
Button1.gpioPin.$name = "Board_BUTTON_S1_GPIO";

Button2.$name         = "Board_BUTTON_S2";
Button2.$hardware     = system.deviceData.board.components.S2;
Button2.gpioPin.$name = "Board_BUTTON_S2_GPIO";

LED1.$hardware = system.deviceData.board.components.LED1_RED;
LED1.$name     = "Board_LED_Red";

LED2.$name     = "Board_LED_Green";
LED2.$hardware = system.deviceData.board.components.LED2_GREEN;

/**
 * Pinmux solution for unlocked pins/peripherals. This ensures that minor changes to the automatic solver in a future
 * version of the tool will not impact the pinmux you originally saw.  These lines can be completely deleted in order to
 * re-solve from scratch.
 */
Button1.gpioPin.gpioPin.$suggestSolution = "P1.1.GPIO/EUSCI_A0_SPI.CLK";
Button2.gpioPin.gpioPin.$suggestSolution = "P1.4.GPIO/EUSCI_B0_SPI.STE";
LED1.gpioPin.gpioPin.$suggestSolution    = "P1.0.GPIO/EUSCI_A0_SPI.STE";
LED2.gpioPin.gpioPin.$suggestSolution    = "P2.1.GPIO/EUSCI_A1_SPI.CLK";

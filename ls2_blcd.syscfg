/**
 * These arguments were used when this file was generated. They will be automatically applied on subsequent loads
 * via the GUI or CLI. Run CLI with '--help' for additional information on how to override these arguments.
 * @cliArgs --board "/ti/boards/MSP_EXP432P401R" --product "simplelink_msp432p4_sdk@3.40.01.02"
 * @versions {"data":"2020090214","timestamp":"2020090214","tool":"1.6.0+1543","templates":"2020090214"}
 */

/**
 * Import the modules used in this configuration.
 */
const GPIO    = scripting.addModule("/ti/drivers/GPIO", {}, false);
const GPIO1   = GPIO.addInstance();
const GPIO2   = GPIO.addInstance();
const GPIO3   = GPIO.addInstance();
const PWM     = scripting.addModule("/ti/drivers/PWM", {}, false);
const PWM1    = PWM.addInstance();
const PWM2    = PWM.addInstance();
const PWM3    = PWM.addInstance();
const Power   = scripting.addModule("/ti/drivers/Power");
const RTOS    = scripting.addModule("/ti/drivers/RTOS");
const Button  = scripting.addModule("/ti/drivers/apps/Button", {}, false);
const Button1 = Button.addInstance();
const Button2 = Button.addInstance();
const LED     = scripting.addModule("/ti/drivers/apps/LED", {}, false);
const LED1    = LED.addInstance();

/**
 * Write custom configuration values to the imported modules.
 */
GPIO1.$name              = "PHASE_A_LIN";
GPIO1.mode               = "Output";
GPIO1.initialOutputState = "High";
GPIO1.gpioPin.$assign    = "expansion.7";

GPIO2.$name              = "PHASE_B_LIN";
GPIO2.mode               = "Output";
GPIO2.initialOutputState = "High";
GPIO2.gpioPin.$assign    = "expansion.32";

GPIO3.$name              = "PHASE_C_LIN";
GPIO3.mode               = "Output";
GPIO3.initialOutputState = "High";
GPIO3.gpioPin.$assign    = "expansion.31";

PWM1.$name                = "PHASE_A_HIN";
PWM1.timer.pwmPin.$assign = "expansion.24";

PWM2.$name                = "PHASE_B_HIN";
PWM2.timer.pwmPin.$assign = "expansion.26";

PWM3.$name                = "PHASE_C_HIN";
PWM3.timer.pwmPin.$assign = "expansion.25";

Power.performanceLevel3.$name = "ti_drivers_power_PowerMSP432PerfLevels0";
Power.performanceLevel2.$name = "ti_drivers_power_PowerMSP432PerfLevels1";
Power.performanceLevel1.$name = "ti_drivers_power_PowerMSP432PerfLevels2";
Power.performanceLevel0.$name = "ti_drivers_power_PowerMSP432PerfLevels3";


Button1.$name         = "Board_BUTTON_S1";
Button1.$hardware     = system.deviceData.board.components.S1;
Button1.gpioPin.$name = "Board_BUTTON_S1_GPIO";

Button2.$name         = "Board_BUTTON_S2";
Button2.$hardware     = system.deviceData.board.components.S2;
Button2.gpioPin.$name = "Board_BUTTON_S2_GPIO";

LED1.$hardware = system.deviceData.board.components.LED1_RED;
LED1.$name     = "Board_LED_0";

/**
 * Pinmux solution for unlocked pins/peripherals. This ensures that minor changes to the automatic solver in a future
 * version of the tool will not impact the pinmux you originally saw.  These lines can be completely deleted in order to
 * re-solve from scratch.
 */
PWM1.timer.$suggestSolution              = "Timer_A1";
PWM2.timer.$suggestSolution              = "Timer_A1";
PWM3.timer.$suggestSolution              = "Timer_A1";
RTOS.timer0.resource.$suggestSolution    = "Timer_A0";
Button1.gpioPin.gpioPin.$suggestSolution = "P1.1.GPIO/EUSCI_A0_SPI.CLK";
Button2.gpioPin.gpioPin.$suggestSolution = "P1.4.GPIO/EUSCI_B0_SPI.STE";
LED1.gpioPin.gpioPin.$suggestSolution    = "P1.0.GPIO/EUSCI_A0_SPI.STE";
